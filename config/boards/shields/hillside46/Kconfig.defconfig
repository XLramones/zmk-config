## config/boards/shields/hillside46/Kconfig.defconfig
```kconfig
# Copyright (c) 2021-2022 The ZMK Contributors
# SPDX-License-Identifier: MIT
#
# if SHIELD_HILLSIDE46_LEFT
#
# config ZMK_KEYBOARD_NAME
#     default "Hillside46"
#
# config ZMK_SPLIT_BLE_ROLE_CENTRAL
#     default y
#
# endif
#
# if SHIELD_HILLSIDE46_LEFT || SHIELD_HILLSIDE46_RIGHT
#
# config ZMK_SPLIT
#     default y
#
# endif
if SHIELD_HILLSIDE46_RIGHT

config ZMK_KEYBOARD_NAME
    default "Hillside46"

config ZMK_SPLIT_BLE_ROLE_CENTRAL
    default y  # Set right side as central BLE role

config ZMK_SPLIT_ROLE
    default "central"  # Explicitly set right side as master for wired connection

endif

if SHIELD_HILLSIDE46_LEFT

config ZMK_SPLIT_ROLE
    default "peripheral"  # Set left side as peripheral for wired connection

endif

if SHIELD_HILLSIDE46_LEFT || SHIELD_HILLSIDE46_RIGHT

config ZMK_SPLIT
    default y

endif
```
